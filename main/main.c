/*
 * lsm6dsv16x_test — multi-source health test + streaming for LSM6DSV16X IMUs.
 *
 * Bus (ESP32-S3):
 *   GPIO12 -> SCLK, GPIO11 -> MOSI, GPIO13 <- MISO,
 *   one CS GPIO per source (default table: 1,2,4,5,6,7,8,9,10,14,15).
 *
 * Why one hardware CS0 routed through the GPIO matrix instead of one
 * spi_device per source: the S3 SPI peripheral only exposes three hardware CS
 * signals, so 6/11 sources cannot each own a hardware CS. A single SPI device
 * occupies CS0; before each transaction CS0 is routed to the target source's
 * pin and every other CS pin is returned to plain GPIO output (high). Manual
 * gpio_set_level() toggling was tried in an earlier project and read 0x00;
 * routing the hardware CS0 signal keeps the full CS waveform generated by the
 * peripheral. The release step (SIG_GPIO_OUT_IDX) matters: without it the
 * previous pin stays connected to CS0 and two devices are selected at once.
 *
 * The register access uses ST's official platform-independent driver
 * (components/lsm6dsv16x, lsm6dsv16x-pid v6.2.0). This file only supplies the
 * transport and the tests.
 *
 * Output contract (grepped by tools/run_tests.py; do not reword):
 *   UNIT_RESULT <index> <PASS|FAIL|ABSENT> <passed>/<total> raw=0x<xx> <detail>
 *   MATRIX_DONE <n>
 *   SUMMARY present=<n> absent=<n> count=<n>
 */

#include <stdarg.h>
#include <stdbool.h>
#include <stdint.h>
#include <stdio.h>
#include <string.h>

#include <math.h>

#include "driver/gpio.h"
#include "driver/spi_master.h"
#include "esp_log.h"
#include "esp_rom_gpio.h"
#include "esp_timer.h"
#include "freertos/FreeRTOS.h"
#include "freertos/task.h"
#include "lsm6dsv16x_reg.h"
#include "soc/gpio_sig_map.h"
#include "soc/spi_periph.h"

static const char *TAG = "lsm6dsv16x";

/* ------------------------------------------------------------------ config */

#define IMU_PIN_SCLK  GPIO_NUM_12
#define IMU_PIN_MOSI  GPIO_NUM_11
#define IMU_PIN_MISO  GPIO_NUM_13

#define MAX_UNITS     11
#define IMU_SPI_HOST  SPI2_HOST
#define IMU_SPI_HZ    (CONFIG_IMU_SPI_KHZ * 1000)

/* Physical sanity limits for a board sitting still on a desk. */
#define ACC_MAG_MIN_G     0.85f
#define ACC_MAG_MAX_G     1.15f
#define GYRO_BIAS_MAX_DPS 3.0f
#define GYRO_NOISE_MAX_DPS 1.0f

/* A source is declared gone only after this many consecutive identity misses,
 * so one corrupt frame does not flap the UI. */
#define MISS_LIMIT 3
#define HOTPLUG_PERIOD_US 1000000

/* The pin table is the one vetted in the cleanroom project: it avoids the USB
 * pins (19/20), the S3 strapping pins (0/3/45/46) and the N16R8 flash/PSRAM
 * pins. */
static const int k_cs_pins[MAX_UNITS] = {
    CONFIG_IMU_CS_GPIO_0, CONFIG_IMU_CS_GPIO_1, CONFIG_IMU_CS_GPIO_2,
    CONFIG_IMU_CS_GPIO_3, CONFIG_IMU_CS_GPIO_4, CONFIG_IMU_CS_GPIO_5,
    CONFIG_IMU_CS_GPIO_6, CONFIG_IMU_CS_GPIO_7, CONFIG_IMU_CS_GPIO_8,
    CONFIG_IMU_CS_GPIO_9, CONFIG_IMU_CS_GPIO_10,
};

/* ------------------------------------------------------------------- state */

typedef struct {
    int              cs;
    stmdev_ctx_t     ctx;
    bool             present;
    uint8_t          who_am_i;
    uint8_t          misses;
    uint32_t         errors;
    uint32_t         samples_a;
    uint32_t         samples_g;
    bool             sflp_ok;
} imu_unit_t;

static imu_unit_t s_units[MAX_UNITS];
static spi_device_handle_t s_bus_dev;
static int s_routed_cs = -1;
static uint32_t s_st_hist[256];
static int s_block_dump;

/* ------------------------------------------------------- SPI transport ---- */

/* Return a pin to the plain GPIO output driver and force it high. Until this
 * is done the pin is still fed by the SPI CS0 signal and would follow the
 * next transaction's chip select. */
static void cs_release(int cs)
{
    esp_rom_gpio_connect_out_signal(cs, SIG_GPIO_OUT_IDX, false, false);
    gpio_set_level(cs, 1);
}

static void cs_select(int cs)
{
    if (s_routed_cs == cs) {
        return;
    }
    if (s_routed_cs >= 0) {
        cs_release(s_routed_cs);
    }
    esp_rom_gpio_connect_out_signal(cs, spi_periph_signal[IMU_SPI_HOST].spics_out[0],
                                    false, false);
    s_routed_cs = cs;
}

static int32_t unit_transfer(imu_unit_t *u, uint8_t reg, const uint8_t *in,
                             uint8_t *out, uint16_t n)
{
    if (n == 0 || n > 32) {
        return ESP_ERR_INVALID_ARG;
    }

    uint8_t tx[33] = { reg };
    uint8_t rx[33] = { 0 };
    if (in) {
        memcpy(&tx[1], in, n);
    }

    spi_transaction_t t = {
        .length    = (size_t)(n + 1) * 8,
        .rxlength  = out ? (size_t)(n + 1) * 8 : 0,
        .tx_buffer = tx,
        .rx_buffer = out ? rx : NULL,
    };

    /* One owner: the whole select -> frame -> deselect window is held under
     * the bus lock so a second task (the hot-plug probe) cannot reroute CS
     * between the address byte and the payload. */
    int rc = spi_device_acquire_bus(s_bus_dev, portMAX_DELAY);
    if (rc != 0) {
        return rc;
    }
    cs_select(u->cs);
    rc = spi_device_polling_transmit(s_bus_dev, &t);
    /* Leave CS0 routed. Detaching the matrix after every transaction adds a
     * glitch at the next frame's start: the peripheral asserts CS before the
     * reroute settles, the device never decodes the command, and MISO reads
     * 0xFF followed by zeros. The previous source is released only when the
     * next transaction selects a different pin (cs_select). */
    spi_device_release_bus(s_bus_dev);

    if (rc == 0 && out) {
        memcpy(out, &rx[1], n);
    }
    return rc;
}

static int32_t rd(void *h, uint8_t reg, uint8_t *buf, uint16_t len)
{
    return unit_transfer((imu_unit_t *)h, (uint8_t)(reg | 0x80), NULL, buf, len);
}

static int32_t wr(void *h, uint8_t reg, const uint8_t *buf, uint16_t len)
{
    return unit_transfer((imu_unit_t *)h, (uint8_t)(reg & 0x7F), buf, NULL, len);
}

static void mdelay(uint32_t ms)
{
    vTaskDelay(pdMS_TO_TICKS(ms ? ms : 1));
}

/* ------------------------------------------------------------- test log --- */

typedef struct {
    int  passed;
    int  failed;
    char detail[192];
} test_ctx_t;

static void check(test_ctx_t *t, bool ok, const char *fmt, ...)
{
    if (ok) {
        t->passed++;
    } else {
        t->failed++;
    }
    if (!ok && t->detail[0] == '\0') {
        va_list ap;
        va_start(ap, fmt);
        vsnprintf(t->detail, sizeof(t->detail), fmt, ap);
        va_end(ap);
    }
}

static int unit_total(const test_ctx_t *t) { return t->passed + t->failed; }

/* ------------------------------------------------------------ unit setup -- */

static void unit_bind(imu_unit_t *u, int index)
{
    memset(u, 0, sizeof(*u));
    u->cs = k_cs_pins[index];
    u->ctx.write_reg = wr;
    u->ctx.read_reg  = rd;
    u->ctx.mdelay    = mdelay;
    u->ctx.handle    = u;
}

static esp_err_t bus_init(void)
{
    for (int i = 0; i < CONFIG_UNIT_COUNT; i++) {
        int cs = k_cs_pins[i];
        if (cs == 19 || cs == 20) {
            ESP_LOGE(TAG, "CS GPIO%d is a USB pin; refusing to drive it", cs);
            return ESP_ERR_INVALID_ARG;
        }
        for (int j = 0; j < i; j++) {
            if (k_cs_pins[j] == cs) {
                ESP_LOGE(TAG, "duplicate CS GPIO%d in unit table", cs);
                return ESP_ERR_INVALID_ARG;
            }
        }
        gpio_config_t c = {
            .pin_bit_mask = 1ULL << cs,
            .mode         = GPIO_MODE_OUTPUT,
            .pull_up_en   = GPIO_PULLUP_DISABLE,
            .pull_down_en = GPIO_PULLDOWN_DISABLE,
            .intr_type    = GPIO_INTR_DISABLE,
        };
        ESP_ERROR_CHECK(gpio_config(&c));
        cs_release(cs); /* idle high before the bus is enabled */
    }

    spi_bus_config_t bus = {
        .miso_io_num     = IMU_PIN_MISO,
        .mosi_io_num     = IMU_PIN_MOSI,
        .sclk_io_num     = IMU_PIN_SCLK,
        .quadwp_io_num   = -1,
        .quadhd_io_num   = -1,
        .max_transfer_sz = 64,
    };
    esp_err_t err = spi_bus_initialize(IMU_SPI_HOST, &bus, SPI_DMA_DISABLED);
    if (err != ESP_OK) {
        return err;
    }

    /* The device occupies hardware CS0 (pin 0 is only the slot anchor; the
     * signal is rerouted per transaction). */
    spi_device_interface_config_t dev = {
        .clock_speed_hz   = IMU_SPI_HZ,
        .mode             = 3,
        .spics_io_num     = k_cs_pins[0],
        .cs_ena_pretrans  = 1,
        .cs_ena_posttrans = 1,
        .queue_size       = 1,
        .flags            = 0, /* full duplex */
    };
    return spi_bus_add_device(IMU_SPI_HOST, &dev, &s_bus_dev);
}

/* ------------------------------------------------------------- identify --- */

static bool identity_probe(imu_unit_t *u)
{
    uint8_t id = 0;
    int32_t rc = lsm6dsv16x_device_id_get(&u->ctx, &id);
    u->who_am_i = id;
    return rc == 0 && id == LSM6DSV16X_ID;
}

/* Configure one present source. Every step's return code and the raw readback
 * are checked; the driver's own returns are not a substitute for readback. */
static bool unit_configure(imu_unit_t *u, test_ctx_t *t, bool verbose)
{
    int32_t rc;
    bool ok = true;

#define STEP(expr, what)                                            \
    do {                                                            \
        rc = (expr);                                                \
        if (verbose) check(t, rc == 0, what " rc=%ld", (long)rc);   \
        ok = ok && (rc == 0);                                       \
    } while (0)

    STEP(lsm6dsv16x_sw_por(&u->ctx), "sw_por");
    if (!ok) {
        return false;
    }
    vTaskDelay(pdMS_TO_TICKS(20));

#ifdef CONFIG_USE_BDU
    STEP(lsm6dsv16x_block_data_update_set(&u->ctx, PROPERTY_ENABLE), "bdu");
#else
    STEP(lsm6dsv16x_block_data_update_set(&u->ctx, PROPERTY_DISABLE), "bdu off");
#endif
    STEP(lsm6dsv16x_xl_full_scale_set(&u->ctx, LSM6DSV16X_2g), "xl fs");
    STEP(lsm6dsv16x_gy_full_scale_set(&u->ctx, LSM6DSV16X_2000dps), "gy fs");
    STEP(lsm6dsv16x_xl_mode_set(&u->ctx, LSM6DSV16X_XL_HIGH_PERFORMANCE_MD), "xl mode");
    STEP(lsm6dsv16x_gy_mode_set(&u->ctx, LSM6DSV16X_GY_HIGH_PERFORMANCE_MD), "gy mode");
    STEP(lsm6dsv16x_xl_data_rate_set(&u->ctx, LSM6DSV16X_ODR_AT_120Hz), "xl odr");
    STEP(lsm6dsv16x_gy_data_rate_set(&u->ctx, LSM6DSV16X_ODR_AT_120Hz), "gy odr");
#undef STEP

    uint8_t ctrl1 = 0, ctrl2 = 0, ctrl3 = 0, ctrl6 = 0, ctrl8 = 0, st = 0;
    lsm6dsv16x_read_reg(&u->ctx, LSM6DSV16X_CTRL1, &ctrl1, 1);
    lsm6dsv16x_read_reg(&u->ctx, LSM6DSV16X_CTRL2, &ctrl2, 1);
    lsm6dsv16x_read_reg(&u->ctx, LSM6DSV16X_CTRL3, &ctrl3, 1);
    lsm6dsv16x_read_reg(&u->ctx, LSM6DSV16X_CTRL6, &ctrl6, 1);
    lsm6dsv16x_read_reg(&u->ctx, LSM6DSV16X_CTRL8, &ctrl8, 1);
    lsm6dsv16x_read_reg(&u->ctx, LSM6DSV16X_STATUS_REG, &st, 1);
    ESP_LOGI(TAG, "  unit %d: CTRL1=0x%02X CTRL2=0x%02X CTRL3=0x%02X "
                  "CTRL6=0x%02X CTRL8=0x%02X STATUS=0x%02X",
             (int)(u - s_units), ctrl1, ctrl2, ctrl3, ctrl6, ctrl8, st);
    if (verbose) {
        check(t, ctrl1 == 0x06, "CTRL1 readback 0x%02X (want 0x06)", ctrl1);
        check(t, ctrl2 == 0x06, "CTRL2 readback 0x%02X (want 0x06)", ctrl2);
        check(t, (ctrl3 & 0x04) != 0, "CTRL3 IF_INC clear (0x%02X)", ctrl3);
        check(t, (ctrl6 & 0x0F) == 0x04, "CTRL6 FS_G=%u (want 4=2000dps)",
              ctrl6 & 0x0F);
    }
    ok = ok && ctrl1 == 0x06 && ctrl2 == 0x06;
    return ok;
}

/* ------------------------------------------------------------ sampling ---- */

static bool read_sample(imu_unit_t *u, float acc_g[3], float gyro_dps[3],
                        bool *have_acc, bool *have_gyro)
{
    /* Read STATUS as a raw byte: the bit-field view is fine for control but
     * hides which exact flag was set when a frame looks corrupt. */
    uint8_t st = 0;
    if (lsm6dsv16x_read_reg(&u->ctx, LSM6DSV16X_STATUS_REG, &st, 1) != 0) {
        return false;
    }
    s_st_hist[st]++;
    bool drdy_xl = (st & 0x01) != 0;
    bool drdy_gy = (st & 0x02) != 0;
    if (!drdy_xl && !drdy_gy) {
        return false;
    }

    int16_t ar[3] = { 0 }, gr[3] = { 0 };
    if (drdy_xl || drdy_gy) {
        /* Gyro (0x22..0x27) and accel (0x28..0x2D) are one contiguous block.
         * Reading it in a single transaction replaces two back-to-back bursts
         * and gives a coherent snapshot under BDU.
         *
         * A breadboard bus can drop the frame after the first byte; that shows
         * up as an all-zero block, never as plausible sensor data (a live
         * accelerometer always reports roughly 1 g). Retry the block instead
         * of feeding the zeros into the statistics. */
        bool valid = false;
        for (int attempt = 0; attempt < 5 && !valid; attempt++) {
            uint8_t buf[12];
#ifdef CONFIG_READ_BYTE_WISE
            const int chunk = 1;
#else
            const int chunk = CONFIG_BURST_LEN;
#endif
            int rc = 0;
            for (int off = 0; off < 12; off += chunk) {
                int n = 12 - off;
                if (n > chunk) {
                    n = chunk;
                }
                rc |= lsm6dsv16x_read_reg(&u->ctx,
                                          (uint8_t)(LSM6DSV16X_OUTX_L_G + off),
                                          &buf[off], (uint16_t)n);
            }
            if (rc != 0) {
                u->errors++;
                continue;
            }
#ifdef CONFIG_DUMP_BLOCK
            if (s_block_dump > 0) {
                s_block_dump--;
                printf("BLOCK %d", (int)(u - s_units));
                for (int k = 0; k < 12; k++) {
                    printf(" %02X", buf[k]);
                }
                printf("\n");
            }
#endif
            for (int i = 0; i < 3; i++) {
                gr[i] = (int16_t)(((uint16_t)buf[2 * i + 1] << 8) | buf[2 * i]);
                ar[i] = (int16_t)(((uint16_t)buf[6 + 2 * i + 1] << 8) | buf[6 + 2 * i]);
            }
            /* A truncated frame shows the first byte and zeros after it. The
             * accelerometer makes that detectable: at rest the vector is
             * ~1 g, so an implausible magnitude means the frame did not
             * arrive intact. 1 g is 16384 LSB at the 2 g range; accept
             * 0.2..3 g and retry anything outside. */
            int64_t a2 = (int64_t)ar[0] * ar[0] + (int64_t)ar[1] * ar[1] +
                         (int64_t)ar[2] * ar[2];
            valid = a2 > 3300LL * 3300 && a2 < 49000LL * 49000;
            if (!valid) {
                u->errors++;
            }
        }
        if (!valid) {
            return false;
        }
    }
    if (drdy_xl) {
        for (int i = 0; i < 3; i++) {
            acc_g[i] = lsm6dsv16x_from_fs2_to_mg(ar[i]) / 1000.0f;
        }
        *have_acc = true;
        u->samples_a++;
    }
    if (drdy_gy) {
        for (int i = 0; i < 3; i++) {
            gyro_dps[i] = lsm6dsv16x_from_fs2000_to_mdps(gr[i]) / 1000.0f;
        }
        *have_gyro = true;
        u->samples_g++;
    }

#ifdef CONFIG_DUMP_RAW
    printf("SAMPLE %d %lld %02X %d %d %d %d %d %d %.3f %.3f %.3f %.3f %.3f %.3f\n",
           (int)(u - s_units), (long long)esp_timer_get_time(), st,
           ar[0], ar[1], ar[2], gr[0], gr[1], gr[2],
           acc_g[0], acc_g[1], acc_g[2], gyro_dps[0], gyro_dps[1], gyro_dps[2]);
#endif
    return true;
}

static void test_data_path(imu_unit_t *u, test_ctx_t *t)
{
    float acc[3] = { 0 }, gyro[3] = { 0 };
    bool  have_acc = false, have_gyro = false;

    for (int i = 0; i < 40 && !(have_acc && have_gyro); i++) {
        read_sample(u, acc, gyro, &have_acc, &have_gyro);
        vTaskDelay(pdMS_TO_TICKS(10));
    }

    check(t, have_acc, "no accelerometer sample");
    check(t, have_gyro, "no gyroscope sample");
    if (!have_acc) {
        return;
    }
    float mag = sqrtf(acc[0] * acc[0] + acc[1] * acc[1] + acc[2] * acc[2]);
    check(t, mag >= 0.5f && mag <= 2.5f, "acc magnitude %.3f g implausible", mag);

    int zero_axes = 0;
    for (int i = 0; i < 3; i++) {
        if (fabsf(acc[i]) < 0.001f) {
            zero_axes++;
        }
    }
    check(t, zero_axes < 2, "%d accel axes exactly zero", zero_axes);
}

static void test_static_window(imu_unit_t *u, test_ctx_t *t)
{
    const int64_t window_us = 1000000;
    int64_t start = esp_timer_get_time();
    double ax = 0, ay = 0, az = 0, gx = 0, gy = 0, gz = 0;
    double gx2 = 0, gy2 = 0, gz2 = 0;
    float  gx_min = 1e9f, gx_max = -1e9f;
    int got_acc = 0, got_gyro = 0;

    memset(s_st_hist, 0, sizeof(s_st_hist));
    s_block_dump = 12;
    while (esp_timer_get_time() - start < window_us) {
        float acc[3] = { 0 }, gyro[3] = { 0 };
        bool have_acc = false, have_gyro = false;
        if (read_sample(u, acc, gyro, &have_acc, &have_gyro)) {
            if (have_acc) {
                ax += acc[0]; ay += acc[1]; az += acc[2]; got_acc++;
            }
            if (have_gyro) {
                gx += gyro[0]; gy += gyro[1]; gz += gyro[2];
                gx2 += (double)gyro[0] * gyro[0];
                gy2 += (double)gyro[1] * gyro[1];
                gz2 += (double)gyro[2] * gyro[2];
                if (gyro[0] < gx_min) gx_min = gyro[0];
                if (gyro[0] > gx_max) gx_max = gyro[0];
                got_gyro++;
            }
        }
        vTaskDelay(pdMS_TO_TICKS(1));
    }

    int64_t elapsed_us = esp_timer_get_time() - start;
    int expected = (int)((elapsed_us * 120) / 1000000);
    ESP_LOGI(TAG, "  unit %d window %.2fs acc=%d gyro=%d expected~%d "
                  "gx[min=%.2f max=%.2f] spi=%dkHz",
             (int)(u - s_units), (double)elapsed_us / 1e6, got_acc, got_gyro,
             expected, got_gyro ? gx_min : 0.0f, got_gyro ? gx_max : 0.0f,
             CONFIG_IMU_SPI_KHZ);

    char hist[160];
    int  ho = 0;
    for (int v = 0; v < 256 && ho < (int)sizeof(hist) - 12; v++) {
        if (s_st_hist[v]) {
            ho += snprintf(hist + ho, sizeof(hist) - ho, "%02X:%u ", v,
                           (unsigned)s_st_hist[v]);
        }
    }
    ESP_LOGI(TAG, "  unit %d status hist: %s", (int)(u - s_units),
             ho ? hist : "(none)");

    check(t, got_acc >= expected * 4 / 5, "only %d accel samples (~%d)", got_acc,
          expected);
    check(t, got_gyro >= expected * 4 / 5, "only %d gyro samples (~%d)",
          got_gyro, expected);
    if (got_acc < expected * 4 / 5 || got_gyro < expected * 4 / 5) {
        return;
    }

    double mag = sqrt((ax / got_acc) * (ax / got_acc) +
                      (ay / got_acc) * (ay / got_acc) +
                      (az / got_acc) * (az / got_acc));
    check(t, mag >= ACC_MAG_MIN_G && mag <= ACC_MAG_MAX_G, "mean |a|=%.3f g",
          mag);

    const double b[3] = { gx / got_gyro, gy / got_gyro, gz / got_gyro };
    const double q[3] = { gx2 / got_gyro, gy2 / got_gyro, gz2 / got_gyro };
    ESP_LOGI(TAG, "  unit %d gyro bias %.2f %.2f %.2f dps",
             (int)(u - s_units), b[0], b[1], b[2]);
    const char *name[3] = { "x", "y", "z" };
    for (int i = 0; i < 3; i++) {
        double var = q[i] - b[i] * b[i];
        double noise = sqrt(var > 0 ? var : 0);
        check(t, fabs(b[i]) <= GYRO_BIAS_MAX_DPS, "gyro %s bias %.2f dps", name[i], b[i]);
        check(t, noise <= GYRO_NOISE_MAX_DPS, "gyro %s noise %.2f dps", name[i], noise);
    }
}

static void test_register_rw(imu_unit_t *u, test_ctx_t *t)
{
    uint8_t before = 0, after = 0;
    int32_t r0 = lsm6dsv16x_read_reg(&u->ctx, LSM6DSV16X_CTRL9, &before, 1);
    uint8_t probe = (uint8_t)(before ^ 0x02); /* toggle a benign config bit */
    int32_t r1 = lsm6dsv16x_write_reg(&u->ctx, LSM6DSV16X_CTRL9, &probe, 1);
    int32_t r2 = lsm6dsv16x_read_reg(&u->ctx, LSM6DSV16X_CTRL9, &after, 1);
    int32_t r3 = lsm6dsv16x_write_reg(&u->ctx, LSM6DSV16X_CTRL9, &before, 1);
    check(t, r0 == 0 && r1 == 0 && r2 == 0 && r3 == 0,
          "CTRL9 rw rc=%ld/%ld/%ld/%ld", (long)r0, (long)r1, (long)r2, (long)r3);
    check(t, after == probe, "CTRL9 readback 0x%02X (wrote 0x%02X)", after, probe);
}

/* -------------------------------------------------------------- per unit -- */

static void run_unit(int index)
{
    imu_unit_t *u = &s_units[index];
    test_ctx_t t = { 0 };
    unit_bind(u, index);

    ESP_LOGI(TAG, "--- unit %d (CS GPIO%d) ---", index, u->cs);

    if (!identity_probe(u)) {
        printf("UNIT_RESULT %d ABSENT 0/0 raw=0x%02X no_device\n", index,
               u->who_am_i);
        fflush(stdout);
        return;
    }
    u->present = true;
    test_ctx_t id = { 0 };
    check(&id, true, "ok");

    test_register_rw(u, &t);

    if (!unit_configure(u, &t, true)) {
        goto report;
    }
    vTaskDelay(pdMS_TO_TICKS(100));

    test_data_path(u, &t);
    test_static_window(u, &t);

report:;
    const char *detail = t.detail[0] ? t.detail : "ok";
    printf("UNIT_RESULT %d %s %d/%d raw=0x%02X %s\n", index,
           t.failed == 0 && t.passed > 0 ? "PASS" : "FAIL", t.passed,
           unit_total(&t), u->who_am_i, detail);
    fflush(stdout);
}

/* ------------------------------------------------------------ stream mode --- */

#if CONFIG_RUN_MODE_STREAM

static float fp16_to_float(uint16_t h)
{
    uint32_t sign = (h >> 15) & 0x1u;
    uint32_t exp  = (h >> 10) & 0x1Fu;
    uint32_t mant = h & 0x3FFu;
    float    v;
    if (exp == 0) {
        v = ldexpf((float)mant, -24);
    } else if (exp == 31) {
        v = mant ? NAN : INFINITY;
    } else {
        v = ldexpf((float)(mant | 0x400u), (int)exp - 25);
    }
    return sign ? -v : v;
}

static void sflp_to_quat(const uint8_t data[6], float q[4])
{
    q[0] = fp16_to_float((uint16_t)(data[0] | (data[1] << 8)));
    q[1] = fp16_to_float((uint16_t)(data[2] | (data[3] << 8)));
    q[2] = fp16_to_float((uint16_t)(data[4] | (data[5] << 8)));
    float sumsq = q[0] * q[0] + q[1] * q[1] + q[2] * q[2];
    if (sumsq > 1.0f) {
        float n = sqrtf(sumsq);
        q[0] /= n; q[1] /= n; q[2] /= n;
        sumsq = 1.0f;
    }
    q[3] = sqrtf(1.0f - sumsq);
}

static bool sflp_init(imu_unit_t *u)
{
    lsm6dsv16x_fifo_sflp_raw_t batch = { 0 };
    lsm6dsv16x_sflp_gbias_t    gbias = { 0 };
    int32_t rc = 0;
    rc |= lsm6dsv16x_fifo_mode_set(&u->ctx, LSM6DSV16X_BYPASS_MODE);
    batch.game_rotation = PROPERTY_ENABLE;
    batch.gravity       = PROPERTY_ENABLE;
    rc |= lsm6dsv16x_fifo_sflp_batch_set(&u->ctx, batch);
    rc |= lsm6dsv16x_sflp_data_rate_set(&u->ctx, LSM6DSV16X_SFLP_60Hz);
    rc |= lsm6dsv16x_sflp_game_gbias_set(&u->ctx, &gbias);
    rc |= lsm6dsv16x_sflp_game_rotation_set(&u->ctx, PROPERTY_ENABLE);
    rc |= lsm6dsv16x_fifo_watermark_set(&u->ctx, 8);
    rc |= lsm6dsv16x_fifo_mode_set(&u->ctx, LSM6DSV16X_STREAM_MODE);
    return rc == 0;
}

static void drain_fifo(imu_unit_t *u, float q[4], bool *have_q)
{
    lsm6dsv16x_fifo_status_t st = { 0 };
    if (lsm6dsv16x_fifo_status_get(&u->ctx, &st) != 0) {
        return;
    }
    for (int guard = 0; guard < 64 && st.fifo_level; guard++) {
        lsm6dsv16x_fifo_out_raw_t e = { 0 };
        if (lsm6dsv16x_fifo_out_raw_get(&u->ctx, &e) != 0) {
            return;
        }
        if (e.tag == LSM6DSV16X_SFLP_GAME_ROTATION_VECTOR_TAG) {
            sflp_to_quat(e.data, q);
            *have_q = true;
        }
        if (lsm6dsv16x_fifo_status_get(&u->ctx, &st) != 0) {
            return;
        }
    }
}

static bool stream_init_unit(imu_unit_t *u)
{
    if (!identity_probe(u)) {
        return false;
    }
    test_ctx_t t = { 0 };
    if (!unit_configure(u, &t, false)) {
        return false;
    }
    u->sflp_ok = sflp_init(u);
    if (!u->sflp_ok) {
        ESP_LOGW(TAG, "unit %d: SFLP unavailable, raw only", (int)(u - s_units));
    }
    u->present = true;
    u->misses  = 0;
    return true;
}

/* Re-check identity so a source that is unplugged stops being reported and a
 * newly plugged source is picked up. Returns true if the state changed. */
static bool hotplug_step(int index)
{
    imu_unit_t *u = &s_units[index];
    bool id_ok = identity_probe(u);
    bool changed = false;

    if (u->present && !id_ok) {
        if (++u->misses >= MISS_LIMIT) {
            u->present = false;
            u->misses  = 0;
            u->sflp_ok = false;
            printf("HOTPLUG %d REMOVED\n", index);
            fflush(stdout);
            changed = true;
        }
    } else if (!u->present && id_ok) {
        if (stream_init_unit(u)) {
            printf("HOTPLUG %d ADDED id=0x%02X\n", index, u->who_am_i);
            fflush(stdout);
            changed = true;
        }
    } else {
        u->misses = 0;
    }
    return changed;
}

static void run_stream(void)
{
    for (int i = 0; i < CONFIG_UNIT_COUNT; i++) {
        unit_bind(&s_units[i], i);
        stream_init_unit(&s_units[i]);
    }

    int live = 0;
    for (int i = 0; i < CONFIG_UNIT_COUNT; i++) {
        live += s_units[i].present ? 1 : 0;
    }
    printf("STREAM_READY %d\n", live);
    fflush(stdout);

    const int period_ms = 1000 / CONFIG_STREAM_HZ;
    int64_t next = esp_timer_get_time();
    int64_t next_hotplug = esp_timer_get_time() + HOTPLUG_PERIOD_US;
    int     hotplug_cursor = 0;

    while (true) {
        /* One write per frame. Writing each source separately pushed the
         * USB-Serial/JTAG link down to ~7 frames/s with 11 slots, because
         * every printf became its own USB transfer. */
        static char buf[4096];
        int off = snprintf(buf, sizeof(buf), "{\"t\":%lld,\"u\":[",
                           (long long)(esp_timer_get_time() / 1000));
        bool first = true;
        for (int i = 0; i < CONFIG_UNIT_COUNT; i++) {
            imu_unit_t *u = &s_units[i];
            if (off < 0 || (size_t)off > sizeof(buf) - 256) {
                break; /* cannot happen with 11 sources; keep the write safe */
            }

            float acc[3] = { 0 }, gyro[3] = { 0 };
            bool  have_acc = false, have_gyro = false;
            float q[4] = { 0, 0, 0, 1 };
            bool  have_q = false;

            if (u->present) {
                read_sample(u, acc, gyro, &have_acc, &have_gyro);
                if (u->sflp_ok) {
                    drain_fifo(u, q, &have_q);
                }
            }

            if (!u->present) {
                off += snprintf(buf + off, sizeof(buf) - off,
                                "%s{\"i\":%d,\"on\":0,\"cs\":%d}",
                                first ? "" : ",", i, u->cs);
                first = false;
                continue;
            }

            off += snprintf(buf + off, sizeof(buf) - off,
                   "%s{\"i\":%d,\"on\":1,\"id\":%d,\"cs\":%d,\"e\":%u,"
                   "\"na\":%u,\"ng\":%u,"
                   "\"a\":[%.3f,%.3f,%.3f],\"g\":[%.3f,%.3f,%.3f],"
                   "\"q\":[%.4f,%.4f,%.4f,%.4f],\"aq\":%d,\"va\":%d,\"vg\":%d}",
                   first ? "" : ",", i, u->who_am_i, u->cs,
                   (unsigned)u->errors, (unsigned)u->samples_a,
                   (unsigned)u->samples_g,
                   acc[0], acc[1], acc[2], gyro[0], gyro[1], gyro[2],
                   q[0], q[1], q[2], q[3],
                   have_q ? 1 : 0, have_acc ? 1 : 0, have_gyro ? 1 : 0);
            first = false;
        }
        if (off < 0) {
            off = 0;
        }
        if ((size_t)off > sizeof(buf) - 3) {
            off = sizeof(buf) - 3;
        }
        off += snprintf(buf + off, sizeof(buf) - off, "]}\n");
        fwrite(buf, 1, (size_t)off, stdout);
        fflush(stdout);

        /* Probe one source per second (round-robin) rather than all at once,
         * so a probe never adds a visible burst to the stream. */
        int64_t now = esp_timer_get_time();
        if (now >= next_hotplug) {
            hotplug_step(hotplug_cursor);
            hotplug_cursor = (hotplug_cursor + 1) % CONFIG_UNIT_COUNT;
            next_hotplug = now + HOTPLUG_PERIOD_US;
        }

        next += (int64_t)period_ms * 1000;
        now = esp_timer_get_time();
        if (next > now) {
            vTaskDelay(pdMS_TO_TICKS((next - now) / 1000));
        } else {
            next = now;
        }
    }
}

#endif /* CONFIG_RUN_MODE_STREAM */

/* -------------------------------------------------------------- diagnosis --- */

#if CONFIG_RUN_MODE_DIAG

/* Direct one-device-per-CS path, deliberately bypassing the dynamic CS0
 * routing used by the normal firmware. If a pin answers here but not through
 * the routed path, the routing is the bug; if it answers nowhere, the pin or
 * the module is. */
static int diag_read(spi_device_handle_t dev, uint8_t reg, uint8_t *buf,
                     uint16_t len)
{
    uint8_t tx[17] = { (uint8_t)(reg | 0x80) };
    uint8_t rx[17] = { 0 };
    spi_transaction_t t = {
        .length = (size_t)(len + 1) * 8,
        .rxlength = (size_t)(len + 1) * 8,
        .tx_buffer = tx,
        .rx_buffer = rx,
    };
    int rc = spi_device_polling_transmit(dev, &t);
    if (rc == 0) {
        memcpy(buf, &rx[1], len);
    }
    return rc;
}

static void diag_pin_level(int cs)
{
    gpio_config_t c = {
        .pin_bit_mask = 1ULL << cs,
        .mode = GPIO_MODE_INPUT_OUTPUT,
        .pull_up_en = GPIO_PULLUP_DISABLE,
        .pull_down_en = GPIO_PULLDOWN_DISABLE,
        .intr_type = GPIO_INTR_DISABLE,
    };
    if (gpio_config(&c) != ESP_OK) {
        printf("DIAG_PIN cs=%d config_failed\n", cs);
        return;
    }
    gpio_set_level(cs, 0);
    int lo = gpio_get_level(cs);
    gpio_set_level(cs, 1);
    int hi = gpio_get_level(cs);
    printf("DIAG_PIN cs=%d drive_low_read=%d drive_high_read=%d %s\n", cs, lo,
           hi, (lo == 0 && hi == 1) ? "OK" : "MISMATCH");
}

static void run_diag(void)
{
    printf("DIAG start units=%d\n", CONFIG_UNIT_COUNT);
    for (int i = 0; i < CONFIG_UNIT_COUNT; i++) {
        diag_pin_level(k_cs_pins[i]);
    }

    /* Cross-check every CS pair: drive one pin, read the other as a floating
     * input. If the second pin follows the first, the two select lines are
     * shorted — both modules then answer every transaction, which looks like a
     * good WHO_AM_I but corrupts every multi-byte data read. */
    for (int a = 0; a < CONFIG_UNIT_COUNT; a++) {
        for (int b = a + 1; b < CONFIG_UNIT_COUNT; b++) {
            int ca = k_cs_pins[a], cb = k_cs_pins[b];
            gpio_config_t out = {
                .pin_bit_mask = 1ULL << ca,
                .mode = GPIO_MODE_INPUT_OUTPUT,
                .pull_up_en = GPIO_PULLUP_DISABLE,
                .pull_down_en = GPIO_PULLDOWN_DISABLE,
                .intr_type = GPIO_INTR_DISABLE,
            };
            gpio_config_t in = {
                .pin_bit_mask = 1ULL << cb,
                .mode = GPIO_MODE_INPUT,
                .pull_up_en = GPIO_PULLUP_DISABLE,
                .pull_down_en = GPIO_PULLDOWN_DISABLE,
                .intr_type = GPIO_INTR_DISABLE,
            };
            gpio_config(&out);
            gpio_config(&in);
            gpio_set_level(ca, 0);
            vTaskDelay(pdMS_TO_TICKS(2));
            int lo = gpio_get_level(cb);
            gpio_set_level(ca, 1);
            vTaskDelay(pdMS_TO_TICKS(2));
            int hi = gpio_get_level(cb);
            if (lo == 0 && hi == 1) {
                printf("DIAG_SHORT cs=%d <-> cs=%d follows (%d/%d)\n", ca, cb,
                       lo, hi);
            }
            /* Restore both as outputs, high. */
            diag_pin_level(ca);
            diag_pin_level(cb);
        }
    }

    spi_bus_config_t bus = {
        .miso_io_num = IMU_PIN_MISO,
        .mosi_io_num = IMU_PIN_MOSI,
        .sclk_io_num = IMU_PIN_SCLK,
        .quadwp_io_num = -1,
        .quadhd_io_num = -1,
        .max_transfer_sz = 64,
    };
    if (spi_bus_initialize(IMU_SPI_HOST, &bus, SPI_DMA_DISABLED) != ESP_OK) {
        printf("DIAG bus_init_failed\n");
        return;
    }

    const int speeds[] = { 100, 400, 1000 };
    const int modes[] = { 0, 3 };
    for (int i = 0; i < CONFIG_UNIT_COUNT; i++) {
        int cs = k_cs_pins[i];
        for (int mi = 0; mi < 2; mi++) {
            for (int si = 0; si < 3; si++) {
                spi_device_interface_config_t d = {
                    .clock_speed_hz = speeds[si] * 1000,
                    .mode = modes[mi],
                    .spics_io_num = cs,
                    .queue_size = 1,
                    .cs_ena_pretrans = 1,
                    .cs_ena_posttrans = 1,
                };
                spi_device_handle_t dev = NULL;
                esp_err_t e = spi_bus_add_device(IMU_SPI_HOST, &d, &dev);
                if (e != ESP_OK) {
                    printf("DIAG cs=%d mode=%d khz=%d add_failed=%d\n", cs,
                           modes[mi], speeds[si], (int)e);
                    continue;
                }
                uint8_t ids[5] = { 0 };
                int rc = 0;
                for (int k = 0; k < 5; k++) {
                    uint8_t id = 0;
                    rc |= diag_read(dev, LSM6DSV16X_WHO_AM_I, &id, 1);
                    ids[k] = id;
                }
                printf("DIAG cs=%d mode=%d khz=%d rc=%d ids=%02X,%02X,%02X,%02X,%02X\n",
                       cs, modes[mi], speeds[si], rc, ids[0], ids[1], ids[2],
                       ids[3], ids[4]);
                if (speeds[si] == 1000) {
                    uint8_t x[12] = { 0 };
                    diag_read(dev, LSM6DSV16X_OUTX_L_G, x, 12);
                    printf("DIAG_MODEBLK cs=%d mode=%d", cs, modes[mi]);
                    for (int k = 0; k < 12; k++) printf(" %02X", x[k]);
                    printf("\n");
                }
                spi_bus_remove_device(dev);
            }
        }
    }
    /* Burst test without the dynamic routing: read 12 bytes from WHO_AM_I.
     * Byte 0 is 0x70 and CTRL3 (offset 3) is 0x44 after power-up, so a burst
     * that stops after the first byte is obvious. */
    for (int i = 0; i < CONFIG_UNIT_COUNT; i++) {
        int cs = k_cs_pins[i];
        spi_device_interface_config_t d = {
            .clock_speed_hz = 1000000,
            .mode = 3,
            .spics_io_num = cs,
            .queue_size = 1,
            .cs_ena_pretrans = 1,
            .cs_ena_posttrans = 1,
        };
        spi_device_handle_t dev = NULL;
        if (spi_bus_add_device(IMU_SPI_HOST, &d, &dev) != ESP_OK) {
            continue;
        }
        for (int t = 0; t < 5; t++) {
            uint8_t b[12] = { 0 };
            int rc = diag_read(dev, LSM6DSV16X_WHO_AM_I, b, 12);
            printf("DIAG_BLOCK cs=%d t=%d rc=%d", cs, t, rc);
            for (int k = 0; k < 12; k++) {
                printf(" %02X", b[k]);
            }
            printf("\n");

            uint8_t d[12] = { 0 };
            rc = diag_read(dev, LSM6DSV16X_OUTX_L_G, d, 12);
            printf("DIAG_DATA cs=%d t=%d rc=%d", cs, t, rc);
            for (int k = 0; k < 12; k++) {
                printf(" %02X", d[k]);
            }
            printf("\n");

            if (t == 0) {
                for (int a = 0x00; a <= 0x03; a++) {
                    uint8_t v = 0;
                    diag_read(dev, (uint8_t)a, &v, 1);
                    printf("DIAG_REG cs=%d a=%02X v=%02X\n", cs, a, v);
                }
                for (int addr = 0x22; addr <= 0x2D; addr++) {
                    uint8_t v = 0;
                    diag_read(dev, (uint8_t)addr, &v, 1);
                    printf("DIAG_BYTE cs=%d a=%02X v=%02X\n", cs, addr, v);
                }
                uint8_t g6[6] = { 0 }, a6[6] = { 0 }, o21[12] = { 0 };
                diag_read(dev, LSM6DSV16X_OUTX_L_G, g6, 6);
                printf("DIAG_G6 cs=%d %02X %02X %02X %02X %02X %02X\n", cs,
                       g6[0], g6[1], g6[2], g6[3], g6[4], g6[5]);
                diag_read(dev, LSM6DSV16X_OUTX_L_A, a6, 6);
                printf("DIAG_A6 cs=%d %02X %02X %02X %02X %02X %02X\n", cs,
                       a6[0], a6[1], a6[2], a6[3], a6[4], a6[5]);
                diag_read(dev, 0x21, o21, 12);
                printf("DIAG_21 cs=%d", cs);
                for (int k = 0; k < 12; k++) printf(" %02X", o21[k]);
                printf("\n");

                if (cs == 1) {
                    for (int start = 0x20; start <= 0x25; start++) {
                        uint8_t x[12] = { 0 };
                        diag_read(dev, (uint8_t)start, x, 12);
                        printf("DIAG_START a=%02X", start);
                        for (int k = 0; k < 12; k++) printf(" %02X", x[k]);
                        printf("\n");
                    }
                    /* Is the second module actually deselected? Read this
                     * module's output block with the other CS forced high,
                     * then forced low. If both look the same, the high level
                     * is not reaching the other module. */
                    for (int level = 1; level >= 0; level--) {
                        gpio_set_level(k_cs_pins[1], level);
                        vTaskDelay(pdMS_TO_TICKS(2));
                        for (int t2 = 0; t2 < 3; t2++) {
                            uint8_t x[12] = { 0 };
                            diag_read(dev, LSM6DSV16X_OUTX_L_G, x, 12);
                            printf("DIAG_ISO other_cs=%d", level);
                            for (int k = 0; k < 12; k++) printf(" %02X", x[k]);
                            printf("\n");
                        }
                    }
                    gpio_set_level(k_cs_pins[1], 1);
                }            }
        }
        spi_bus_remove_device(dev);
    }

    /* Same burst, but through the production path: one device on CS0, bus
     * acquired, CS0 rerouted to the target pin. If this fails while the direct
     * path above succeeds, the reroute/acquire sequence is the defect. */
    spi_device_interface_config_t pd = {
        .clock_speed_hz = 1000000,
        .mode = 3,
        .spics_io_num = k_cs_pins[0],
        .queue_size = 1,
        .cs_ena_pretrans = 1,
        .cs_ena_posttrans = 1,
    };
    spi_device_handle_t prod_dev = NULL;
    if (spi_bus_add_device(IMU_SPI_HOST, &pd, &prod_dev) == ESP_OK) {
        for (int i = 0; i < 2; i++) {
            int cs = k_cs_pins[i];
            spi_device_acquire_bus(prod_dev, portMAX_DELAY);
            for (int j = 0; j < CONFIG_UNIT_COUNT; j++) {
                esp_rom_gpio_connect_out_signal(k_cs_pins[j], SIG_GPIO_OUT_IDX,
                                                false, false);
                gpio_set_level(k_cs_pins[j], 1);
            }
            esp_rom_gpio_connect_out_signal(
                cs, spi_periph_signal[IMU_SPI_HOST].spics_out[0], false, false);
            for (int t = 0; t < 5; t++) {
                uint8_t b[12] = { 0 };
                int rc = diag_read(prod_dev, LSM6DSV16X_WHO_AM_I, b, 12);
                printf("PROD_BLOCK cs=%d t=%d rc=%d", cs, t, rc);
                for (int k = 0; k < 12; k++) {
                    printf(" %02X", b[k]);
                }
                printf("\n");

                uint8_t d[12] = { 0 };
                rc = diag_read(prod_dev, LSM6DSV16X_OUTX_L_G, d, 12);
                printf("PROD_DATA cs=%d t=%d rc=%d", cs, t, rc);
                for (int k = 0; k < 12; k++) {
                    printf(" %02X", d[k]);
                }
                printf("\n");
                printf("PROD_LEVELS cs=%d t=%d", cs, t);
                for (int j = 0; j < 2; j++) {
                    printf(" g%d=%d", k_cs_pins[j],
                           gpio_get_level(k_cs_pins[j]));
                }
                printf("\n");
            }
            spi_device_release_bus(prod_dev);
        }
        spi_bus_remove_device(prod_dev);
    }

    printf("DIAG_DONE\n");
    fflush(stdout);
}

#endif /* CONFIG_RUN_MODE_DIAG */

/* ------------------------------------------------------------------ main -- */

void app_main(void)
{
    vTaskDelay(pdMS_TO_TICKS(100));

#if CONFIG_RUN_MODE_DIAG
    run_diag();
    while (true) {
        vTaskDelay(pdMS_TO_TICKS(10000));
    }
#endif

    if (bus_init() != ESP_OK) {
        printf("BUS_INIT_FAILED\n");
        fflush(stdout);
        abort();
    }
    printf("BUS SPI=%dkHz units=%d mode=test\n", CONFIG_IMU_SPI_KHZ,
           CONFIG_UNIT_COUNT);
    fflush(stdout);

#if CONFIG_RUN_MODE_STREAM
    run_stream(); /* never returns */
#endif

    for (int i = 0; i < CONFIG_UNIT_COUNT; i++) {
        run_unit(i);
    }

    int present = 0;
    for (int i = 0; i < CONFIG_UNIT_COUNT; i++) {
        present += s_units[i].present ? 1 : 0;
    }
    printf("SUMMARY present=%d absent=%d count=%d\n", present,
           CONFIG_UNIT_COUNT - present, CONFIG_UNIT_COUNT);
    printf("MATRIX_DONE %d\n", CONFIG_UNIT_COUNT);
    fflush(stdout);

    while (true) {
        vTaskDelay(pdMS_TO_TICKS(10000));
    }
}
